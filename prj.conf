## CMakeLists.txt
```
set(BOARD "bbc_microbit")

include($ENV{ZEPHYR_BASE}/cmake/app/boilerplate.cmake NO_POLICY_SCOPE)
project(EmbbededSystemsProject)

message(WARNING "Main file: ${PROJECT_SOURCE_DIR}/src/main.c")


list(APPEND SOURCES
    "${PROJECT_SOURCE_DIR}/src/helloworld.c"
    "${PROJECT_SOURCE_DIR}/src/compass.c"
    "${PROJECT_SOURCE_DIR}/src/temperature.c"
    "${PROJECT_SOURCE_DIR}/src/accelerometer.c"
    "${PROJECT_SOURCE_DIR}/src/i2c_utils.c"
    "${PROJECT_SOURCE_DIR}/src/configure.c"
    "${PROJECT_SOURCE_DIR}/src/main.c"
    )

list(APPEND HEADERS
    "${PROJECT_SOURCE_DIR}/src/helloworld.h"
    "${PROJECT_SOURCE_DIR}/src/compass.h"
    "${PROJECT_SOURCE_DIR}/src/temperature.h"
    "${PROJECT_SOURCE_DIR}/src/accelerometer.h"
    "${PROJECT_SOURCE_DIR}/src/includes.h"
    "${PROJECT_SOURCE_DIR}/src/i2c_utils.h"
    "${PROJECT_SOURCE_DIR}/src/configure.h"
    "${PROJECT_SOURCE_DIR}/src/state.h"
    )

target_sources(app PRIVATE ${SOURCES})
target_sources(app PRIVATE ${HEADERS})
```

## prj.conf
```kconfig
# nothing here

CONFIG_SENSOR=y
CONFIG_STDOUT_CONSOLE=y

CONFIG_GPIO=y
CONFIG_MICROBIT_DISPLAY=y
CONFIG_SYS_CLOCK_TICKS_PER_SEC=250

CONFIG_I2C=y
CONFIG_I2C_INIT_PRIORITY=60
CONFIG_I2C_0=y

CONFIG_I2C_GPIO=y
CONFIG_I2C_GPIO_0=y
CONFIG_I2C_GPIO_0_GPIO=y
CONFIG_I2C_GPIO_0_SCL_PIN=19
CONFIG_I2C_GPIO_0_SDA_PIN=20

CONFIG_SYS_LOG=y
CONFIG_SYS_LOG_DEFAULT_LEVEL=4
CONFIG_SYS_LOG_SHOW_COLOR=y
```

## src/main.c
```c
#include "configure.h"

/*! \mainpage Página Principal
 *
 * \section intro_sec Descrição
 *
 * Este projeto foi delegado aos estudantes da turma de Sistemas Embarcados, no período de 2017.2, pelo professor da Universidade Federal de Alagoas (UFal) Rodrigo Peixoto. O estudo realizado aqui tem como principal proposta exercitar os conhecimentos aprendidos em sala de aula, referentes aos conceitos e técnicas no que tange o desenvolvimento de e para sistemas embarcados. Desta forma, foi proposto o desenvolvimento de cinco casos de teste, que contemplassem os conceitos aprendidos, anteriormente mencionados, e as funcionalidades presentes na placa utilizada, a MicroBit.
 * Os cinco casos de teste consistiam em:
    - Caso 01: Mostrar o texto "ECOM042.2017.2" no display de forma que ele fique passando no display.
    - Caso 02: Deve utilizar o acelerômetro para movimentar um ponto (apenas um led da matriz) que dependendo da posição da placa ele vai se mover;
    - Caso 03: Deve utilizar a bússola para mostrar onde está o norte magnético. Essa indicação deve ser feita na matriz de leds;
    - Caso 04: Mostrar a temperatura capturada pelo sensor da placa em graus célsius;
    - Caso 05: Deve utilizar o bluetooth para interagir com um aparelho externo (ex. celular ou computador) deve trocar dados nessa interação. Fica a critério do aluno definir como mostrar que a troca de dados ocorre de forma correta. Dica, pode mostrar na matriz de led o valor passado pelo outro computador.
 *
 *  Onde somente quatro se fizeram possíveis de serem implementados.
 *
 * \section install_sec Execução do Projeto
 *
 * Para execução do projeto desenvolvido para este projeto, deve-se baixá-lo do repositório online e instalar algumas depedências:
 * \code{.unparsed}
 * sudo apt-get install putty
 * git clone https://github.com/BrunoGeorgevich/EmbbededSystemsProject
 * \endcode
 *
 * Logo em seguida, deve-se entrar no diretório baixado, através do comando:
 * \code{.unparsed}
 * cd EmbbededSystemsProject
 * \endcode
 *
 * Para que então se possa compilar e gerar o binário referente a MicroBit:
 * \code{.unparsed}
 * cd build
 * cmake ..
 * make -j7
 * \endcode
 *
 * Caso todo o processo de compilação e geração tenha dado certo, agora basta copiar o binário gerado e copiá-lo para a MicroBit:
 * \code{.unparsed}
 * cp zephyr/zephyr.bin [CAMINHO PARA A SUA MICROBIT]
 * \endcode
 *
 * Tendo copiado o binário para a MicroBit a mesma irá reiniciar e desconectar do computador. Logo após ela automaticamente reconectar, execute a linha de comando abaixo para comunicar-se com ela via serial:
 * \code{.unparsed}
 * sudo putty /dev/ttyACM0 -serial -sercfg 115200,8,n,1,N
 * \endcode
 *
 * Para gerar a documentação para o mesmo, deve-se executar as seguites linhas de código:
 * \code{.unparsed}
 * cd ../src/ && doxygen dox_config
 * \endcode
 *
 */

int main() {
    init_sensors();
    configure_buttons();
    init_state_machine();

    while (PROGRAM_RUNS_CORRECTLY) {
        current_state->run();
    }

    return NO_ERRORS;
}
```

## src/accelerometer.c
```c
#include "accelerometer.h"

int translate_pos_accelerometer(int32_t val) {
    if(val >= 0 && val <= 51) {
        return 4;
    }
    if(val >= 52 && val <= 103) {
        return 3;
    }
    if(val >= 104 && val <= 155) {
        return 2;
    }
    if(val >= 156 && val <= 207) {
        return 1;
    }
    if(val >= 208 && val <= 255) {
        return 0;
    }
    else {
#ifdef DEBUG
        printk("MAJOR THAN 255 OR MINOR THAN 0 -> %d\n", val);
#endif
        return -1;
    }
}

void accelerometer_display(int32_t x, int32_t y) {

    struct mb_image __dot = MB_IMAGE(
    { 0, 0, 0, 0, 0 },
    { 0, 0, 0, 0, 0 },
    { 0, 0, 0, 0, 0 },
    { 0, 0, 0, 0, 0 },
    { 0, 0, 0, 0, 0 });

    __dot.row[translate_pos_accelerometer(y)] = (1 << translate_pos_accelerometer(x));

    struct mb_display *disp = mb_display_get();
    mb_display_image(disp, MB_DISPLAY_MODE_SINGLE,
                     K_MSEC(REFRESH_TIME_ACCELEROMETER), &__dot, 1);
    k_sleep(K_MSEC(REFRESH_TIME_ACCELEROMETER));
}

void accelerometer_showcase() {
    uint8_t data_msb[1];
    uint8_t data_lsb[1];

    uint16_t x,y,z;
    i2c_util_read_bytes(&accelerometer, 0x1, data_msb, sizeof(data_msb));
    i2c_util_read_bytes(&accelerometer, 0x2, data_lsb, sizeof(data_lsb));

    data_lsb[0] = (data_msb[0] << 2) | (data_lsb[0] >> 6);
    x = data_lsb[0];

#ifdef DEBUG
    printk("ACC X: %d\n", x);
#endif

    i2c_util_read_bytes(&accelerometer, 0x3, data_msb, sizeof(data_msb));
    i2c_util_read_bytes(&accelerometer, 0x4, data_lsb, sizeof(data_lsb));

    data_lsb[0] = (data_msb[0] << 2) | (data_lsb[0] >> 6);
    y = data_lsb[0];

#ifdef DEBUG
    printk("ACC Y: %d\n", y);
#endif

    i2c_util_read_bytes(&accelerometer, 0x5, data_msb, sizeof(data_msb));
    i2c_util_read_bytes(&accelerometer, 0x6, data_lsb, sizeof(data_lsb));

    data_lsb[0] = (data_msb[0] << 2) | (data_lsb[0] >> 6);
    z = data_lsb[0];

#ifdef DEBUG
    printk("ACC Z: %d\n", z);
    printk("------------------------------------\n", z);
#endif

    accelerometer_display(x,y);
    k_sleep(K_MSEC(REFRESH_TIME_ACCELEROMETER));
}

void init_accelerometer() {
    i2c_util_dev_init(&accelerometer, ACCELEROMETER_ADDRESS, "ACC", ACCELEROMETER_REGISTER,
                      ACCELEROMETER_TEST);
    u8_t bit_activator = 1;
    i2c_util_write_bytes(&accelerometer, 0x2A, &bit_activator, sizeof(u8_t));
}
```

## src/accelerometer.h
```c
/****************************************************************************
 * Copyright (C) 2018 by Bruno Georgevich Ferreira                          *
 * Github : https://github.com/brunogeorgevich/                             *
 ***************************************************************************/

/**
 * @file accelerometer.h
 * @author Bruno Georgevich Ferreira
 * @date 27 May 2018
 * @brief Este arquivo contém as funções, constantes e variáveis relacionadas a funcionalidade do Acelerômetro
 */
#ifndef ACCELEROMETER_H
#define ACCELEROMETER_H

#include "includes.h"

#define ACCELEROMETER_ADDRESS   0x1D /**< Endereço do Acelerômetro */
#define ACCELEROMETER_REGISTER  0x0D /**< Registrador do Acelerômetro */
#define ACCELEROMETER_TEST      0x5A /**< Código de Teste do Acelerômetro */

#define REFRESH_TIME_ACCELEROMETER 16 /**< Tempo de Reiterção do Acelerômetro*/

/**
 * @brief Variável responsável por estabelecer a comunicação I²C com o Acelerômetro
 */
struct i2c_dev accelerometer;
/**
 * @brief Função que traduz os valores coletados pelo Acelerômetro para uma posição em uma Matriz 5x5
 * @param int val - Valor que será mapeado de 0 a 4
 */
int translate_pos_accelerometer(int32_t val);
/**
 * @brief Função que irá representar a variação do Acelerômetro em uma Matriz 5x5
 * @param int x - Coordenada X coletada do Acelerômetro
 * @param int x - Coordenada Y coletada do Acelerômetro
 */
void accelerometer_display(int32_t x, int32_t y);
/**
 * @brief Função que irá executar a funcionalidade do Acelerômetro Implementada
 */
void accelerometer_showcase();
/**
 * @brief Função que irá iniciar as variáveis responsáveis pelo bom funcionamento do Acelerômetro
 */
void init_accelerometer();

#endif //ACCELEROMETER_H
```

## src/compass.c
```c
#include "compass.h"


void compass_display() {

    struct mb_display *disp = mb_display_get();

    char *str = "T";

    mb_display_print(disp, MB_DISPLAY_MODE_SINGLE, K_MSEC(REFRESH_TIME_COMPASS), str);
    k_sleep(K_MSEC(REFRESH_TIME_COMPASS)*strlen(str));
}

void compass_showcase() {
    int8_t data_msb[1];
    int8_t data_lsb[1];

    int16_t x,y,z;
    //X_LSB = 0x2 | Y_LSB = 0x4 | Z_LSB = 0x6
    i2c_util_read_bytes(&compass, 0x1, data_msb, sizeof(data_msb));
    i2c_util_read_bytes(&compass, 0x2, data_lsb, sizeof(data_lsb));

    x = data_msb[0] << 8 | data_lsb[0];

#ifdef DEBUG
    printk("COMPASS X: %d\n", x);
#endif

    i2c_util_read_bytes(&compass, 0x3, data_msb, sizeof(data_msb));
    i2c_util_read_bytes(&compass, 0x4, data_lsb, sizeof(data_lsb));

    y = data_msb[0] << 8 | data_lsb[0];

#ifdef DEBUG
    printk("COMPASS Y: %d\n", y);
#endif

    i2c_util_read_bytes(&compass, 0x5, data_msb, sizeof(data_msb));
    i2c_util_read_bytes(&compass, 0x6, data_lsb, sizeof(data_lsb));

    z = data_msb[0] << 8 | data_lsb[0];

#ifdef DEBUG
    printk("COMPASS Z: %d\n", z);
    printk("------------------------------------\n", z);
#endif

    compass_display();
}

void init_compass() {
    i2c_util_dev_init(&compass, COMPASS_ADDRESS, "COMPASS", COMPASS_REGISTER, COMPASS_TEST);

    u8_t bit_activator = 1;
    i2c_util_write_bytes(&compass, 0x10, &bit_activator, sizeof(u8_t));
}
```

## src/compass.h
```c
/****************************************************************************
 * Copyright (C) 2018 by Bruno Georgevich Ferreira                          *
 * Github : https://github.com/brunogeorgevich/                             *
 ***************************************************************************/

/**
 * @file compass.h
 * @author Bruno Georgevich Ferreira
 * @date 27 May 2018
 * @brief Este arquivo contém as funções, constantes e variáveis relacionadas a funcionalidade da Bússola
 */
#ifndef COMPASS_H
#define COMPASS_H

#include "includes.h"

#define COMPASS_ADDRESS         0x0e /**< Endereço da Bússola */
#define COMPASS_REGISTER        0x07 /**< Registrador da Bússola */
#define COMPASS_TEST            0xC4 /**< Código de Teste da Bússola */


#define REFRESH_TIME_COMPASS 1000 /**< Tempo de Reiterção da Bússola */

/**
 * @brief Variável responsável por estabelecer a comunicação I²C com a Bússola
 */
struct i2c_dev compass;
/**
 * @brief Função que irá mostrar na Matriz 5x5 um "T"
 */
void compass_display();

/**
 * @brief Função que irá executar a funcionalidade da Bússola Implementada
 */
void compass_showcase();

/**
 * @brief Método que irá iniciar as variáveis responsáveis pelo bom funcionamento da Bússola
 */
void init_compass();

#endif //COMPASS_H
```

## src/configure.c
```c
#include "configure.h"

struct state state_machine[4] = {
{MAGNETOMETER  , HELLOWORLD    , TEMPERATURE   ,    helloworld_showcase},
{HELLOWORLD    , TEMPERATURE   , ACCELETOMETER ,    temperature_showcase},
{TEMPERATURE   , ACCELETOMETER , MAGNETOMETER  ,    accelerometer_showcase},
{ACCELETOMETER , MAGNETOMETER  , HELLOWORLD    ,    compass_showcase},
};

void button_pressed(struct device *dev, struct gpio_callback *cb, u32_t pins)
{
    if (pins & BIT(SW0_GPIO_PIN)) {
#ifdef DEBUG
        printk("A pressed\n");
#endif
        if (k_uptime_delta(&a_timestamp) < K_MSEC(100)) {
#ifdef DEBUG
            printk("Too quick A presses\n");
#endif
            return;
        }
    } else {
#ifdef DEBUG
        printk("B pressed\n");
#endif
        if (k_uptime_delta(&b_timestamp) < K_MSEC(100)) {
#ifdef DEBUG
            printk("Too quick B presses\n");
#endif
            return;
        }
    }

    if (pins & BIT(SW0_GPIO_PIN)) {
        current_state_t = current_state->s[0];
    } else {
        current_state_t = current_state->s[2];
    }

    current_state = &state_machine[current_state_t];
}

void configure_buttons()
{
    static struct gpio_callback button_cb;
    struct device *gpio;

    gpio = device_get_binding(SW0_GPIO_NAME);

    gpio_pin_configure(gpio, SW0_GPIO_PIN,
                       (GPIO_DIR_IN | GPIO_INT | GPIO_INT_EDGE |
                        GPIO_INT_ACTIVE_LOW));
    gpio_pin_configure(gpio, SW1_GPIO_PIN,
                       (GPIO_DIR_IN | GPIO_INT | GPIO_INT_EDGE |
                        GPIO_INT_ACTIVE_LOW));
    gpio_init_callback(&button_cb, button_pressed,
                       BIT(SW0_GPIO_PIN) | BIT(SW1_GPIO_PIN));
    gpio_add_callback(gpio, &button_cb);

    gpio_pin_enable_callback(gpio, SW0_GPIO_PIN);
    gpio_pin_enable_callback(gpio, SW1_GPIO_PIN);
}

void init_sensors()
{
    init_accelerometer();
    init_compass();
    init_temperature_sensor();
}

void init_state_machine() {
    current_state_t = HELLOWORLD;
    current_state = &state_machine[current_state_t];
}
```

## src/configure.h
```c
/****************************************************************************
 * Copyright (C) 2018 by Bruno Georgevich Ferreira                          *
 * Github : https://github.com/brunogeorgevich/                             *
 ***************************************************************************/

/**
 * @file configure.h
 * @author Bruno Georgevich Ferreira
 * @date 27 May 2018
 * @brief Este arquivo contém as funções, constantes e variáveis responsáveis por configurar e abstrair os Sensores da MicroBit
 */
#ifndef CONFIGURE_H
#define CONFIGURE_H

#include "includes.h"

#include "helloworld.h"
#include "temperature.h"
#include "accelerometer.h"
#include "compass.h"

#include "state.h"

#define PROGRAM_RUNS_CORRECTLY 1 /**< Constante responsável por agregar legibilidade ao loop de iterações da execução do estado atual */
#define NO_ERRORS 0 /**< Constante responsável por agregar legibilidade ao retorno 0 da função Main */
#define DEBUG /**< Constante responsável por habilitar os printk's do código */

/**
 * @brief Variável responsável por armazenar o momento que o qual o último clique foi realizado no Botão A
 */
s64_t a_timestamp;

/**
 * @brief Variável responsável por armazenar o momento que o qual o último clique foi realizado no Botão B
 */
s64_t b_timestamp;

/**
 * @brief Variável responsável por armazenar o estados predefinidos da Máquina de Estados
 */
extern struct state state_machine[4];

/**
 * @brief Variável responsável por referenciar o tipo do estado atual
 */
enum state_t current_state_t;

/**
 * @brief Variável responsável por referenciar o estado atual
 */
struct state *current_state;

/**
 * @brief Função que irá identificar o botão apertado e executar a ação delegada ao mesmo
 */
void button_pressed(struct device *dev, struct gpio_callback *cb,
                    u32_t pins);

/**
 * @brief Função responsável por configurar os botões e seus devidos pinos e callbacks
 */
void configure_buttons(void);

/**
 * @brief Função responsável por inicializar todos os sensores utilizados no projeto
 */
void init_sensors(void);

/**
 * @brief Função responsável por inicializar a Máquina de Estados
 */
void init_state_machine(void);

#endif //CONFIGURE_H
```

## src/helloworld.c
```c
#include "helloworld.h"

void helloworld_showcase() {
    struct mb_display *disp = mb_display_get();

    char *str = "ECOM042.2017.2";

    mb_display_print(disp, MB_DISPLAY_MODE_SINGLE, K_MSEC(REFRESH_TIME_HELLOWORLD), str);
    k_sleep(K_MSEC(REFRESH_TIME_HELLOWORLD)*strlen(str));
}
```

## src/helloworld.h
```c
/****************************************************************************
 * Copyright (C) 2018 by Bruno Georgevich Ferreira                          *
 * Github : https://github.com/brunogeorgevich/                             *
 ***************************************************************************/

/**
 * @file helloworld.h
 * @author Bruno Georgevich Ferreira
 * @date 27 May 2018
 * @brief Este arquivo contém as funções, constantes e variáveis relacionadas a funcionalidade HelloWorld
 */
#ifndef HELLOWORLD_H
#define HELLOWORLD_H

#include "includes.h"

#define REFRESH_TIME_HELLOWORLD 1000 /**< Tempo de Reiterção do HelloWorld*/

/**
 * @brief Função que irá executar a funcionalidade HelloWorld Implementada
 */
void helloworld_showcase();

#endif //HELLOWORLD_H
```

## src/i2c_utils.c
```c
#include "i2c_utils.h"

int i2c_util_dev_init(struct i2c_dev *i2c_dev, u16_t addr, const char *name,
                        u8_t reg_test, u8_t reg_test_expected_val)
{
        i2c_dev->addr = addr;
        strcpy(i2c_dev->name, name);
        i2c_dev->reg_test = reg_test;
        i2c_dev->reg_test_expected_val = reg_test_expected_val;

        int ret;
        i2c_dev->dev = device_get_binding(CONFIG_I2C_GPIO_0_NAME);
        if (!i2c_dev->dev) {
            printk("I2C: Device driver not found.\n");
            return 1;
        }

        ret = i2c_configure(i2c_dev->dev, I2C_SPEED_SET(I2C_SPEED_STANDARD) |
                                I2C_MODE_MASTER);
        if(ret) {
            SYS_LOG_ERR("Could not configure I2C device. Erro code: %d", ret);
            goto ret_err;
        }
        SYS_LOG_INF("device %s Configured successfuly.", i2c_dev->name);

        u8_t id = 0;
        ret = i2c_util_read_bytes(i2c_dev, i2c_dev->reg_test, &id, 1);
        if (ret) {
            SYS_LOG_WRN("Could not comunicate with %s. Error Code %d",
                        i2c_dev->name, ret);
            goto ret_err;
        }

        if (id == i2c_dev->reg_test_expected_val) {
                SYS_LOG_DBG("I2C test Success. Read value: 0x%X!", id);
        }
        else {
                SYS_LOG_WRN("I2C test Fail. Read value: 0x%X | Expected \
                                value: 0x%X", id,
                                i2c_dev->reg_test_expected_val);
                goto ret_err;
        }

ret_err:
        return ret;
}

int i2c_util_write_bytes(struct i2c_dev *i2c_dev, u8_t reg, u8_t *data, u32_t num_bytes)
{
        struct i2c_msg msgs[2];

        /* Send the address to read from */

        msgs[0].buf = &reg;
        msgs[0].len = 1;
        msgs[0].flags = I2C_MSG_WRITE;

        /* Read from device. STOP after this. */
        msgs[1].buf = data;
        msgs[1].len = num_bytes;
        msgs[1].flags = I2C_MSG_WRITE | I2C_MSG_STOP;

        return i2c_transfer(i2c_dev->dev, &msgs[0], 2, i2c_dev->addr);
}

int i2c_util_read_bytes(struct i2c_dev *i2c_dev, u8_t reg, u8_t *data, u32_t num_bytes)
{
        struct i2c_msg msgs[2];

        /* Send the address to read from */

        msgs[0].buf = &reg;
        msgs[0].len = 1;
        msgs[0].flags = I2C_MSG_WRITE;

        /* Read from device. STOP after this. */
        msgs[1].buf = data;
        msgs[1].len = num_bytes;
        msgs[1].flags = I2C_MSG_READ | I2C_MSG_STOP;

        return i2c_transfer(i2c_dev->dev, msgs, 2, i2c_dev->addr);
}

int i2c_util_test_connection(struct i2c_dev *i2c_dev)
{
        int ret;
        u8_t id = 0;
        ret = i2c_util_read_bytes(i2c_dev, i2c_dev->reg_test, &id, 1);
        if (ret) {
            SYS_LOG_WRN("Could not comunicate with %s. Error Code %d",
                        i2c_dev->name, ret);
            goto ret_err;
        }

        if (id == i2c_dev->reg_test_expected_val) {
                SYS_LOG_DBG("I2C test Success. Read value: 0x%X!", id);
        }
        else {
                SYS_LOG_WRN("I2C test Fail. Read value: 0x%X | Expected \
                                value: 0x%X", id,
                                i2c_dev->reg_test_expected_val);
                goto ret_err;
        }

ret_err:
        return ret;
}
```

## src/i2c_utils.h
```c
/****************************************************************************
 * Copyright (C) 2018 by Bruno Georgevich Ferreira                          *
 * Github : https://github.com/brunogeorgevich/                             *
 ***************************************************************************/

/**
 * @file i2c_utils.h
 * @author Zephyr
 * @brief Este arquivo contém as constantes, funções e variáveis relacionadas a Comunicação I²C
 */
#ifndef __I2C_UTIL_H
#define __I2C_UTIL_H

#include <zephyr.h>
#include <misc/printk.h>
#include <board.h>
#include <gpio.h>
#include <device.h>
#include <i2c.h>
#include <string.h>

#define SYS_LOG_DOMAIN "PROJECT"
#include <logging/sys_log.h>

#define I2C_DEVICE_NAME_LENGTH 10

struct i2c_dev {
        struct device *dev;
        char name[I2C_DEVICE_NAME_LENGTH];
        u16_t addr;
        u8_t reg_test;
        u8_t reg_test_expected_val;
};

int i2c_util_dev_init(struct i2c_dev *i2c_dev, u16_t addr, const char *name, u8_t reg_test, u8_t reg_test_expected_val);
int i2c_util_write_bytes(struct i2c_dev *i2c_dev, u8_t reg, u8_t *data, u32_t num_bytes);
int i2c_util_read_bytes(struct i2c_dev *i2c_dev, u8_t reg, u8_t *data, u32_t num_bytes);
int i2c_util_test_connection(struct i2c_dev *i2c_dev);

#endif //__I2C_UTIL_H
```

## src/includes.h
```c
/****************************************************************************
 * Copyright (C) 2018 by Bruno Georgevich Ferreira                          *
 * Github : https://github.com/brunogeorgevich/                             *
 ***************************************************************************/

/**
 * @file includes.h
 * @author Bruno Georgevich Ferreira
 * @date 27 May 2018
 * @brief Este arquivo contém todas as bibliotecas necessárias para os arquivos .h
 */
#ifndef INCLUDES_H
#define INCLUDES_H

#include <zephyr.h>
#include <zephyr/types.h>
#include <misc/printk.h>
#include <misc/util.h>
#include <stddef.h>
#include <board.h>
#include <gpio.h>
#include <device.h>
#include <sensor.h>
#include <string.h>
#include <pwm.h>

#include <bluetooth/bluetooth.h>
#include <bluetooth/hci.h>

#include <display/mb_display.h>

#include "i2c_utils.h"

#endif //INCLUDES_H
```

## src/state.h
```c
/****************************************************************************
 * Copyright (C) 2018 by Bruno Georgevich Ferreira                          *
 * Github : https://github.com/brunogeorgevich/                             *
 ***************************************************************************/

/**
 * @file state.h
 * @author Bruno Georgevich Ferreira
 * @date 27 May 2018
 * @brief Este arquivo contém as constantes e variáveis relacionadas a Máquina de Estados
 */
#ifndef STATE_H
#define STATE_H

/**
 * @brief Enum responsável por definir os estados da Máquina de Estados
 */
enum state_t{
    HELLOWORLD,     /**< Estado 1 */
    TEMPERATURE,    /**< Estado 2 */
    ACCELETOMETER,  /**< Estado 3 */
    MAGNETOMETER   /**< Estado 4 */
};

/**
 * @brief Struct que modela o formato de um estado da Máquina de Estados
 */
struct state {
    union {
        struct internal_states{ /**< Referencia os estado anterior, atual e posterior */
            enum state_t previous; /**< Referencia o estado anterior */
            enum state_t current;  /**< Referencia o estado atual */
            enum state_t next;     /**< Referencia o estado posterior */
        };
        enum state_t s[3]; /**< Permite o acesso às referencias dos estados por um Array */
    };

    void (*run)(void); /**< Referencia o método a ser executado pelo estado atual */
};

#endif //STATE_H
```
